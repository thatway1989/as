## com/as.application/Kconfig
```kconfig
source "$ASROOT/com/as.application/board.$BOARD/Kconfig"

config IS_ASTOOL
    bool
    default n

if !IS_ASTOOL
menu "Run Time Environment"
config RTE
	bool "Run Time Environment"
	default y if ARCH_POSIX

config RTE_SWC_TELLTALE
	bool "demo telltale software component"
	default y if ARCH_POSIX && DIO
	depends on RTE

config RTE_SWC_GAUGE
	bool "demo gauge software component"
	default y if ARCH_POSIX && STMO
	depends on RTE

config RTE_SWC_LINAPP
	bool "demo Lin App software component"
	default y
	depends on RTE && LINIF

config COMMONXML
	bool "default as config arxml"
	default y
	depends on !BOOTLOADER

endmenu

menu "ASCORE simple test case"
config TEST
	bool "some simple test case for ascore"
	default n

config PTHREAD_TEST
	bool "askar pthread test case"
	depends on ASKAR && PTHREAD && TEST
	default n


config FEE_TEST
	bool "FEE test case"
	depends on FEE && TEST
	default n

config EA_TEST
	bool "EA test case"
	depends on EA && TEST
	default n

config NVM_TEST
	bool "NVM test case"
	depends on NVM && TEST
	default n

config DEM_TEST
	bool "DEM test case"
	depends on DEM && TEST
	default n

endmenu
endif
```

## com/as.application/board.any/pyas/Kconfig
```kconfig
config ARCH_ANY
    bool
    default y
    select DEFAULT_ANYOS
    select IS_ASTOOL

config ARCH
    string
    default "host"

config PYAS
    bool
    default y

config DET
    bool
    default y

config PYBIND11
	bool "use pybinder 11 or not, default sip"
	default n
```

## com/as.infrastructure/arch/posix/Kconfig
```kconfig
if ARCH_POSIX
menu "AUTOSAR MCAL&CDD for arch posix"

config CAN
	bool "MCAL CAN driver"
	default y

config DIO
	bool "MCAL DIO driver"
	default y

config LIN
	bool "MCAL LIN driver"
	default y

config FATFS_DRV
	bool "FATFS diskio driver"
	default y

config LWEXT4_DRV
	bool "LWEXT4 blockdev driver"
	default y

config EEP
	bool "MCAL EEP driver"
	default y

config FLASH
	bool "HIS FLASH driver for bootloader"
	default n

config FLS
	bool "MCAL FLS driver"
	default y

config IPC
	bool "Inter Processor Communication driver"
	default n
	help
	  This driver is used to simulate the Inter Processor Communication device
	  for the purpose to study RPMSG&VIRTIO

config LCD
	bool "LCD driver"
	default y

choice
	prompt "LCD simulated by"
	default GTK

config GTK
	bool "gtk"
	depends on LCD

config OPENVG
	bool "openvg(windows only)"
	depends on LCD

config SDL
	bool "SDL2.0"
	depends on LCD

endchoice

config MCU
	bool "MCAL MCU driver"
	default y

config PORT
	bool "MCAL PORT driver"
	default y

config STMO
	bool "Step Motor driver"
	default y
	help
	  This driver is used to simulate the step motor which if usually used by
	  instrument cluster as gauge pointer.

choice
	prompt "ethernet driver"
	default LWIP_DRV

config LWIP_DRV
	bool "LWIP driver"

config UIP_DRV
	bool "micro IP driver from contiki"

config NO_ETH_DRV
	   bool "disabled"

endchoice

config AWS
	bool "AS remote websock device"
	default n

endmenu
endif
```

## com/as.infrastructure/communication/Kconfig
```kconfig
menu "AUTOSAR Communication Stack"

config CANIF
	bool "Communication CAN Interface"
	depends on CAN
	default y

config CANNM
	bool "Communication CAN Network Management"
	depends on CANIF
	default y

config CANSM
	bool "Communication CAN State Manager"
	depends on CANIF
	default y

config CANTP
	bool "Communication CAN Transport Layer"
	depends on CANIF
	default y

config CANTP_MINI
	bool "Mini Communication CAN Transport Layer"
	depends on CANTP
	default n

config LINIF
	bool "Communication LIN Interface"
	depends on LIN
	default y

config LINTP
	bool "Communication LIN Transport Layer"
	depends on LINIF
	default y

config LINTPGW
	bool "Communication LINTP/CANTP Gateway"
	depends on LINTP && CANTP
	default y

config COM
	bool "Communication Signals"
	depends on PDUR
	default y

config COMM
	bool "Communication Manager"
	depends on PDUR
	default y

config DOIP
	bool "Diagnostic Over IP"
	depends on SOAD
	default y

config NM
	bool "Network Manager"
	depends on CANNM
	default y

config OSEKNM
	bool "OSEK Network Managment"
	depends on CANIF
	default y

config PDUR
	bool "PDU Router"
	depends on (CANIF || SOAD)
	default y

config RPMSG
	bool "Remote Processor Message"
	depends on IPC
	default y

config SOAD
	bool "Socket Adapter"
	depends on (LWIP || UIP)
	default y

config XCP
	bool "Extened Calibration Protocol"
	depends on PDUR
	default y

config J1939TP
	bool "J1939 Transport Layer"
	depends on PDUR
	default y

endmenu
```

## com/as.tool/lua/Kconfig
```kconfig
config LUA
	bool "LUA"
	depends on !PYAS && !ASLIB
	default y

config LUA_ASLIB
	bool
	depends on LUA
	default y

config LUA_DEV
	bool "as device library"
	default y

config LUA_DEV_RS232
	bool "as rs232 device"
	depends on LUA_DEV
	default y

config LUA_DEV_LIN
	bool "as LIN device"
	depends on LUA_DEV
	default y

config LUA_DEV_LIN_SOCKET
	bool "as LIN BUS on socket"
	depends on LUA_DEV_LIN
	default y

config LUA_CAN
	bool "as CAN library"
	default y

config LUA_SERIAL_CAN
	bool "as CAN on serial device"
	depends on LUA_CAN
	default y

config LUA_PEAK_CAN
	bool "as PEAK CAN device"
	depends on LUA_CAN
	default n

config LUA_ZLG_CAN
	bool "as ZLG CAN device"
	depends on LUA_CAN
	default n

config LUA_VXL_CAN
	bool "as VXL CAN device"
	depends on LUA_CAN
	default y

config LUA_SOCKET_CAN
	bool "as socket virtual CAN device"
	depends on LUA_CAN
	default y
```
